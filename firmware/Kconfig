## firmware/Kconfig
```kconfig
menu "Z1 PRO experimental adaptation"
config Z1PRO_LOW_LATENCY
    bool "Z1PRO bounded, coalescing BLE mouse queue"
    default y
endmenu
```

## firmware/boards/others/zaopin_z1pro/Kconfig.zaopin_z1pro
```kconfig
config BOARD_ZAOPIN_Z1PRO
    select SOC_NRF52840_QIAA
    select ZMK_BOARD_COMPAT
```

## firmware/boards/others/zaopin_z1pro/board.yml
```yaml
board:
  name: zaopin_z1pro
  full_name: Zaopin Z1 PRO experimental USB port
  vendor: others
  socs:
    - name: nrf52840
```

## firmware/boards/others/zaopin_z1pro/zaopin_z1pro_nrf52840_defconfig
```kconfig
CONFIG_ARM_MPU=y
CONFIG_HW_STACK_PROTECTION=y
CONFIG_GPIO=y
CONFIG_PINCTRL=y
CONFIG_USE_DT_CODE_PARTITION=y
```

## west.yml
```yaml
manifest:
  projects:
    - name: zmk
      url: https://github.com/zmkfirmware/zmk
      revision: 4dd95d7840eb3d5a3f59bb29fbf1ab054715ef85
      clone-depth: 1
    - name: zephyr
      url: https://github.com/zmkfirmware/zephyr
      revision: 10ba6d0cb38bc3d258775d27982f707599320085
      clone-depth: 1
    - name: cmsis
      url: https://github.com/zephyrproject-rtos/cmsis
      revision: d1b8b20b6278615b00e136374540eb1c00dcabe7
      path: modules/hal/cmsis
      clone-depth: 1
    - name: hal_nordic
      url: https://github.com/zephyrproject-rtos/hal_nordic
      revision: 37ca068d7b013fb65a2acc9306bffa48a3e72839
      path: modules/hal/nordic
      clone-depth: 1
    - name: segger
      url: https://github.com/zephyrproject-rtos/segger
      revision: cf56b1d9c80f81a26e2ac5727c9cf177116a4692
      path: modules/debug/segger
      clone-depth: 1
    - name: tinycrypt
      url: https://github.com/zephyrproject-rtos/tinycrypt
      revision: 1012a3ebee18c15ede5efc8332ee2fc37817670f
      path: modules/crypto/tinycrypt
      clone-depth: 1
    - name: mbedtls
      url: https://github.com/zephyrproject-rtos/mbedtls
      revision: 4952e1328529ee549d412b498ea71c54f30aa3b1
      path: modules/crypto/mbedtls
      clone-depth: 1
    - name: lvgl
      url: https://github.com/zmkfirmware/lvgl
      revision: f1db87ee98f1810328a8419572fa42a3b5f352ae
      path: modules/lib/gui/lvgl
      clone-depth: 1
    - name: paw3395
      url: https://github.com/greengrocer98/zmk-paw3395-driver
      revision: 586803f02441b7d84f12f077a2fca540b3e9d9d5
      path: modules/custom/paw3395
      clone-depth: 1
```
